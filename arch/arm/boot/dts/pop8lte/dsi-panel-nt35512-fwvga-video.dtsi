/* Copyright (c) 2014, The Linux Foundation. All rights reserved.
 *
 * This program is free software; you can redistribute it and/or modify
 * it under the terms of the GNU General Public License version 2 and
 * only version 2 as published by the Free Software Foundation.
 *
 * This program is distributed in the hope that it will be useful,
 * but WITHOUT ANY WARRANTY; without even the implied warranty of
 * MERCHANTABILITY or FITNESS FOR A PARTICULAR PURPOSE.  See the
 * GNU General Public License for more details.
 */

/*---------------------------------------------------------------------------
 * This file is autogenerated file using gcdb parser. Please do not edit it.
 * Update input XML file to add a new entry or update variable in this file
 * VERSION = "1.0"
 *---------------------------------------------------------------------------*/
&mdss_mdp {
	dsi_nt35512_fwvga_vid: qcom,mdss_dsi_nt35512_fwvga_video {
		qcom,mdss-dsi-panel-name = "nt35512 video mode dsi panel";
		qcom,mdss-dsi-panel-controller = <&mdss_dsi0>;
		qcom,mdss-dsi-panel-type = "dsi_video_mode";
		qcom,mdss-dsi-panel-destination = "display_1";
        qcom,mdss-dsi-panel-framerate = <50>;
		qcom,mdss-dsi-virtual-channel-id = <0>;
		qcom,mdss-dsi-stream = <0>;
		qcom,mdss-dsi-panel-width = <480>;
		qcom,mdss-dsi-panel-height = <854>;
		qcom,mdss-dsi-h-front-porch = <100>;
		qcom,mdss-dsi-h-back-porch = <140>;
		qcom,mdss-dsi-h-pulse-width = <120>;
		qcom,mdss-dsi-h-sync-skew = <0>;
		qcom,mdss-dsi-v-back-porch = <10>;
		qcom,mdss-dsi-v-front-porch = <20>;
		qcom,mdss-dsi-v-pulse-width = <2>;
		qcom,mdss-dsi-h-left-border = <0>;
		qcom,mdss-dsi-h-right-border = <0>;
		qcom,mdss-dsi-v-top-border = <0>;
		qcom,mdss-dsi-v-bottom-border = <0>;
		qcom,mdss-dsi-bpp = <24>;
		qcom,mdss-dsi-color-order = "rgb_swap_rgb";
		qcom,mdss-dsi-underflow-color = <0xff>;
		qcom,mdss-dsi-border-color = <0>;
		qcom,mdss-dsi-on-command = [
	        39 01 00 00 00 00 06
	            BD 01 A3 20 10 01
			15 01 00 00 00 00 02
	            6F 02

	        39 01 00 00 00 00 06
				F0 55 AA 52 08 01
			15 01 00 00 00 00 02
				B0 0D
			15 01 00 00 00 00 02
				B6 36
			15 01 00 00 00 00 02
				B1 0D
			15 01 00 00 00 00 02
				B7 24
			15 01 00 00 00 00 02
				B2 00
			15 01 00 00 00 00 02
				B8 36
			15 01 00 00 00 00 02
				BF 01
			15 01 00 00 00 00 02
				B3 0F
			15 01 00 00 00 00 02
				B9 34
			15 01 00 00 00 00 02
				B5 08
			15 01 00 00 00 00 02
				BA 14
	        39 01 00 00 00 00 04
		        BC 00 78 00
	        39 01 00 00 00 00 04
		        BD 00 78 00
	        39 01 00 00 00 00 03
		        BE 00 5F
	        39 01 00 00 00 00 35
				D1 00 78 00 7B 00 87 00 92 00
				9C 00 AE 00 C0 00 E0 00 FC 01
				2F 01 5C 01 A7 01 E8 01 EB 02
				2B 02 71 02 9C 02 DA 02 FC 03
				2C 03 4D 03 6E 03 91 03 B6 03
				BF 03 F9
	        39 01 00 00 00 00 35
				D2 00 A0 00 A3 00 AD 00 B6 00
				BE 00 CF 00 DE 00 FA 01 14 01
				44 01 6D 01 B4 01 F4 01 F5 02
				33 02 76 02 A1 02 DD 02 FE 03
				2E 03 4D 03 6F 03 87 03 AA 03
				C0 03 F9
	        39 01 00 00 00 00 35
				D3 00 00 00 09 00 1D 00 2F 00
				40 00 5C 00 75 00 A2 00 C9 01
				08 01 3E 01 95 01 DD 01 E3 02
				23 02 6C 02 98 02 D4 02 F5 03
				2A 03 45 03 65 03 96 03 AD 03
				F9 03 F9
	        39 01 00 00 00 00 35
				D4 00 78 00 7B 00 87 00 92 00
				9C 00 AE 00 C0 00 E0 00 FC 01
				2F 01 5C 01 A7 01 E8 01 EB 02
				2B 02 71 02 9C 02 DA 02 FC 03
				2C 03 4D 03 6E 03 91 03 B6 03
				BF 03 F9
	        39 01 00 00 00 00 35
				D5 00 A0 00 A3 00 AD 00 B6 00
				BE 00 CF 00 DE 00 FA 01 14 01
				44 01 6D 01 B4 01 F4 01 F5 02
				33 02 76 02 A1 02 DD 02 FE 03
				2E 03 4D 03 6F 03 87 03 AA 03
				C0 03 F9
	        39 01 00 00 00 00 35
				D6 00 00 00 09 00 1D 00 2F 00
				40 00 5C 00 75 00 A2 00 C9 01
				08 01 3E 01 95 01 DD 01 E3 02
				23 02 6C 02 98 02 D4 02 F5 03
				2A 03 45 03 65 03 96 03 AD 03
				F9 03 F9
	        39 01 00 00 00 00 06
		        F0 55 AA 52 08 00
			15 01 00 00 00 00 02
				B5 6B
			15 01 00 00 00 00 02
				DE 19
			15 01 00 00 00 00 02
				B6 05
	        39 01 00 00 00 00 03
	    	    B7 77 77
	        39 01 00 00 00 00 05
				B8 01 03 03 03
			15 01 00 00 00 00 02
				BC 02
			15 01 00 00 00 00 02
				DE 1E
	        39 01 00 00 00 00 04
		        B1 6A 00 01
	        39 01 00 00 00 00 0C
	        CE 00 FF FF FF FF B0 C1 D2 E3 0A 80
			05 01 00 00 78 00 02 11 00
			05 01 00 00 8C 00 02 29 00];
		qcom,mdss-dsi-off-command = [05 01 00 00 02 00 02 28 00
					05 01 00 00 79 00 02 10 00];
		qcom,mdss-dsi-on-command-state = "dsi_lp_mode";
		qcom,mdss-dsi-off-command-state = "dsi_hs_mode";
		qcom,mdss-dsi-h-sync-pulse = <1>;
		qcom,mdss-dsi-traffic-mode = "burst_mode";
		qcom,mdss-dsi-lane-map = "lane_map_0123";
		qcom,mdss-dsi-bllp-eof-power-mode;
		qcom,mdss-dsi-bllp-power-mode;
		qcom,mdss-dsi-lane-0-state;
		qcom,mdss-dsi-lane-1-state;
//		qcom,mdss-dsi-lane-2-state;
//		qcom,mdss-dsi-lane-3-state;
		qcom,mdss-dsi-panel-timings = [BB 1A 10 00 3E 40 16 1E 15 03 04 00];
		qcom,mdss-dsi-t-clk-post = <0x04>;
		qcom,mdss-dsi-t-clk-pre = <0x33>;
		qcom,mdss-dsi-panel-clockrate = <419300000>;
		qcom,mdss-dsi-bl-min-level = <1>;
		qcom,mdss-dsi-bl-max-level = <255>;
		qcom,mdss-dsi-dma-trigger = "trigger_sw";
		qcom,mdss-dsi-mdp-trigger = "none";
		qcom,mdss-dsi-bl-pmic-control-type = "bl_ctrl_wled";
		qcom,mdss-dsi-reset-sequence = <1 20>, <0 200>, <1 20>;
		qcom,mdss-pan-physical-width-dimension = <0>;
		qcom,mdss-pan-physical-height-dimension = <0>;
	};
};
